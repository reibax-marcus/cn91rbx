## local_yocto_tools/conf/bblayers.conf
```bitbake
# POKY_BBLAYERS_CONF_VERSION is increased each time build/conf/bblayers.conf
# changes incompatibly
POKY_BBLAYERS_CONF_VERSION = "2"

BBPATH = "${TOPDIR}"
BBFILES ?= ""

# RBXOS_PRJ_TOPDIR is supposed to be an os environment variable
# Access to bitbake should be allowing by including it to
# BB_ENV_EXTRAWHITE environment variable
BBLAYERS ?= " \
  ${RBXOS_PRJ_TOPDIR}/poky/meta \
  ${RBXOS_PRJ_TOPDIR}/poky/meta-poky \
  ${RBXOS_PRJ_TOPDIR}/poky/meta-yocto-bsp \
  ${RBXOS_PRJ_TOPDIR}/meta-solidrun \
  ${RBXOS_PRJ_TOPDIR}/meta-rbxos \
  ${RBXOS_PRJ_TOPDIR}/meta-swupdate \
  ${RBXOS_PRJ_TOPDIR}/meta-scipy \
  ${RBXOS_PRJ_TOPDIR}/meta-openembedded/meta-oe \
  ${RBXOS_PRJ_TOPDIR}/meta-openembedded/meta-python \
  ${RBXOS_PRJ_TOPDIR}/meta-openembedded/meta-networking \
  ${RBXOS_PRJ_TOPDIR}/meta-openembedded/meta-filesystems \
  ${RBXOS_PRJ_TOPDIR}/meta-openembedded/meta-webserver \
  ${RBXOS_PRJ_TOPDIR}/meta-openembedded/meta-perl \
  ${RBXOS_PRJ_TOPDIR}/meta-swupdate-rbxos \
  "
```
